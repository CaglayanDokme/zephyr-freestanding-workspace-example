## sample-zephyr-app/west.yml
```yaml
manifest:
  version: 1.0

  projects:
    - name: zephyr
      url: https://github.com/zephyrproject-rtos/zephyr
      revision: v4.4.2
      import:
        path-prefix: zephyrproject
        name-allowlist:
          - cmsis_6
          - hal_stm32
```
